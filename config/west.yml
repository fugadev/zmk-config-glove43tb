## config/west.yml
```yaml
manifest:
  remotes:
    - name: zmkfirmware
      url-base: https://github.com/zmkfirmware
    - name: keebkuro
      url-base: https://github.com/keebkuro
    - name: badjeff
      url-base: https://github.com/badjeff
    - name: kot149
      url-base: https://github.com/kot149
    - name: oleksandrmaslov
      url-base: https://github.com/oleksandrmaslov  
  projects:
    - name: zmk
      remote: zmkfirmware
      revision: v0.3
      import: app/west.yml
    - name: zmk-pmw3610-driver
      remote: badjeff
      revision: zmk-0.3
    - name: zmk-rgbled-widget
      url: https://github.com/caksoylar/zmk-rgbled-widget
      revision: v0.3
    - name: zmk-scroll-snap
      remote: kot149
      revision: v1
    - name: zmk-pointing-acceleration
      remote: oleksandrmaslov
      revision: main
  self:
    path: config
```
